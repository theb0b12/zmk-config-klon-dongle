#include "klon_dongle.dtsi"

/ {
    chosen {
        zmk,kscan = &kscan_dongle;
    };

    kscan_dongle: kscan_dongle {
        compatible = "zmk,kscan-mock";
        columns = <0>;
        rows = <0>;
        events = <0>;
    };
};

&physical_layout_klon_dongle {
    kscan = <&kscan_dongle>;
};